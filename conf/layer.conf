## conf/layer.conf
```bitbake
# We have a conf and classes directory, add to BBPATH
BBPATH .= ":${LAYERDIR}"

# We have recipes-* directories, add to BBFILES
BBFILES += "${LAYERDIR}/recipes-*/*/*.bb \
            ${LAYERDIR}/recipes-*/*/*.bbappend"

BBFILE_COLLECTIONS += "meta-compulab-webkit"
BBFILE_PATTERN_meta-compulab-webkit = "^${LAYERDIR}/"
BBFILE_PRIORITY_meta-compulab-webkit = "6"

LAYERDEPENDS_meta-compulab-webkit = "core"
LAYERSERIES_COMPAT_meta-compulab-webkit = "mickledore"
```
